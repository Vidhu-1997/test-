AUTOSAR XML (schema 4-0-3)
package /ExamplePackage
  ecu instance ExampleECU: description=Sample ECU instance for demonstration
  application sw component type ExampleSWC
    provide port ExamplePort
